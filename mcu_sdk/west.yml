## mcu_sdk/west.yml
```yaml
manifest:
  remotes:
    - name: nxproject-rtos
      url-base: https://github.com/zephyrproject-rtos
    - name: nxp-mcuxpresso
      url-base: https://github.com/nxp-mcuxpresso
    - name: nxp_zephyr
      url-base: https://github.com/nxp-zephyr
    - name: nxp
      url-base: https://github.com/NXP
  defaults:
    remote: nxp-mcuxpresso
  group-filter:
  - -optional
  projects:
    - name: core
      path: mcuxsdk/
      repo-path: mcuxsdk-core
      revision: e570f283a05a8cc291ac1165b405168250b9717a
      west-commands: scripts/west_commands.yml
      groups:
      - core
      - ble_nxp
      userdata:
        track_branch: release/25.09.00
        branch_flow: true
    - name: CMSIS
      repo-path: mcu-sdk-cmsis
      path: mcuxsdk/arch/arm/CMSIS
      revision: 360049cdcff5aad83c31fc67112255edbf5ccc6b
      groups:
      - core
      - ble_nxp
      userdata:
        track_branch: mcux_main
        branch_flow: false
    - name: mcu-sdk-components
      repo-path: mcux-component
      revision: bcf7fef88d50f038ee6e500601ad0a2e18f83473
      path: mcuxsdk/components
      groups:
      - components
      - ble_nxp
      userdata:
        track_branch: release/25.09.00
        branch_flow: true
    - name: els_pkc
      userdata:
        owner: vit.chmelar@nxp.com
        track_branch: mcux_main
        branch_flow: false
      path: mcuxsdk/components/els_pkc
      revision: 5a52647b25af2b59515b29bbe348208875c5418a
      url: https://github.com/NXP/els_pkc
      groups:
      - security
      - els_pkc
    - name: freertos-kernel
      path: mcuxsdk/rtos/freertos/freertos-kernel
      revision: 5e5f13ae34ea9464f4e311450373523e04a4722b
      groups:
      - freertos-kernel
      - rtos
      - ble_nxp
      userdata:
        owner: michal.princ@nxp.com
        track_branch: release/25.09.00
        branch_flow: true
    - name: mcux-freertos-drivers
      userdata:
        owner: david.jurajda@nxp.com
        track_branch: main
        branch_flow: false
      path: mcuxsdk/rtos/freertos/freertos-drivers
      revision: 845ff93b52bbc1852c5b9911e74524f6baed2ba6
      groups:
      - rtos
      - freertos
    - name: corepkcs11
      userdata:
        owner: michal.princ@nxp.com
        track_branch: release/25.09.00
        branch_flow: true
      path: mcuxsdk/rtos/freertos/corepkcs11
      revision: cdfefdcc61662e84e67e46cc4ca5242ab9227ea2
      groups:
      - freertos
      - aws_iot
    - name: coremqtt
      userdata:
        owner: michal.princ@nxp.com
        track_branch: release/25.09.00
        branch_flow: true
      path: mcuxsdk/rtos/freertos/coremqtt
      revision: d10b9b8096db1af7097dced99eba5e805967764c
      groups:
      - freertos
      - aws_iot
    - name: corejson
      userdata:
        owner: michal.princ@nxp.com
        track_branch: release/25.09.00
        branch_flow: true
      path: mcuxsdk/rtos/freertos/corejson
      revision: ca64c02c436912b5dc505e56fedc5d343f891687
      groups:
      - freertos
      - aws_iot
    - name: corehttp
      userdata:
        owner: michal.princ@nxp.com
        track_branch: release/25.09.00
        branch_flow: true
      path: mcuxsdk/rtos/freertos/corehttp
      revision: 48d97e74d3150a8aac476f0bc744dd9cdf49431f
      groups:
      - freertos
      - aws_iot
    - name: backoffalgorithm
      userdata:
        owner: michal.princ@nxp.com
        track_branch: release/25.09.00
      path: mcuxsdk/rtos/freertos/backoffalgorithm
      revision: fa891d609939f9ef3019779dc2d23ace1a7f9f15
      groups:
      - freertos
      - aws_iot
    - name: freertos-plus-tcp
      userdata:
        owner: michal.princ@nxp.com
        track_branch: release/25.09.00
        branch_flow: true
      path: mcuxsdk/rtos/freertos/freertos-plus-tcp
      revision: ef5bcc28ffea075c892f91c5e55ce0db4c084dca
      groups:
      - freertos
    - name: coremqtt-agent
      userdata:
        owner: michal.princ@nxp.com
        track_branch: release/25.09.00
        branch_flow: true
      path: mcuxsdk/rtos/freertos/coremqtt-agent
      revision: bddeb2b35194e5ccc998dc87a6f173425f2a87ea
      groups:
      - freertos
      - aws_iot
    - name: mcux-devices-lpc
      revision: fe228b87e081a1938f6211b4c60926a333ed93fb
      path: mcuxsdk/devices/LPC
      groups:
      - core
      userdata:
        track_branch: release/25.09.00
        branch_flow: true
    - name: mcux-devices-mcx
      revision: 6bbddd36a6efe653c4633b064705dd9f30e32ac8
      path: mcuxsdk/devices/MCX
      groups:
      - core
      - ble_nxp
      userdata:
        track_branch: release/25.09.00
        branch_flow: true
    - name: mbedtls
      userdata:
        owner: vit.chmelar@nxp.com
        track_branch: release/25.09.00
        branch_flow: false
      path: mcuxsdk/middleware/mbedtls
      revision: 691440bfbfd31bbddaf8471e29aea6fb03ae59e2
      groups:
      - mbedtls
      - security
    - name: mbedtls3x
      userdata:
        owner: ruchika.gupta_1@nxp.com
        dev_branch: mcux_main
        track_branch: mcux_main
        branch_flow: false
      path: mcuxsdk/middleware/mbedtls3x
      remote: nxp
      repo-path: nxp_mbedtls
      revision: 1b2f8fca21678f21f1bc2c06051d254400cc720c
      groups:
      - mbedtls3x
      - security
    - name: usb
      userdata:
        owner: yichang.wang@nxp.com
        track_branch: main
        branch_flow: false
      revision: fae72b7af511b5097c8b8e2c16337215c0bab058
      path: mcuxsdk/middleware/usb
      repo-path: mcux-sdk-middleware-usb
      groups:
      - usb
      - middleware
    - name: fatfs
      revision: 59413c3a18725f6fdcb7f1f8bc2aae468a4dc244
      path: mcuxsdk/middleware/fatfs
      groups:
      - fatfs
      - middleware
      userdata:
        track_branch: mcux_main
        branch_flow: false
    - name: mcux-sdk-middleware-sdmmc
      userdata:
        owner: yangbo.lu@nxp.com
        track_branch: mcux_main
      revision: 371144ab8ad2aa8775144fd3a0ac2bb8aa5f5cb0
      path: mcuxsdk/middleware/sdmmc
      groups:
      - sdmmc
      - middleware
    - name: pkcs11
      userdata:
        owner: michal.chromec@nxp.com
        track_branch: release/24.12.00
      path: mcuxsdk/middleware/pkcs11
      revision: 7e42bd48bbf02ad4a85010309919ac176373f4b4
      groups:
      - pkcs11
      - aws_iot
    - name: lwip
      revision: 2419440fdf626eeedca31be06f3941678e82110d
      path: mcuxsdk/middleware/lwip
      groups:
      - lwip
      - middleware
      userdata:
        track_branch: mcux_main
        branch_flow: false
    - name: nxp_iot_agent
      userdata:
        owner: bojan.simoneta@nxp.com
        track_branch: main
        branch_flow: false
      remote: nxp
      repo-path: el2go-agent
      path: mcuxsdk/middleware/nxp_iot_agent
      revision: 4dba8500c59aa802891742affd99e7857c67a8c4
      groups:
      - nxp_iot_agent
      - security
  self:
    path: nxmw
```
